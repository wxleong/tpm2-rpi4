/*
 * Device Tree overlay for the Infineon Trusted Platform Module
 */

/dts-v1/;
/plugin/;

/ {
	compatible = "brcm,bcm2835";

	fragment@0 {
		target = <&i2c_arm>;
		__overlay__ {
			#address-cells = <1>;
			#size-cells = <0>;
			status = "okay";

			tpm: tpm@2e {
				compatible = "tcg,tpm-tis-i2c";
				reg = <0x2e>;
				status = "okay";
			};
		};
	};
};
